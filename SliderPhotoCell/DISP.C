
 /****************************************
 *                                       *
 *   DDDDD    IIIIII   SSSSS   PPPPPP    *
 *   DD  DD     II    SS   SS  PP   PP   *
 *   DD   DD    II    SS       PP   PP   *
 *   DD   DD    II     SSSSS   PPPPPP    *
 *   DD   DD    II         SS  PP        *
 *   DD  DD     II    SS   SS  PP        *
 *   DDDDD    IIIIII   SSSSS   PP        *
 *                                       *
 ****************************************/

#include <p18F4525.h>
#include "dev12.h"


/* table to convert ascii character to graphics bit values */
CONST char ascii[128][8] = {
   { 0x00,0x00,0x00,0x00,0x00,0x00,0x00,0x00 },    // NULL
   { 0x00,0x55,0x55,0x55,0x55,0x55,0x55,0x55 },    // BORDER
   { 0xFF,0x00,0xFF,0x00,0xFF,0x00,0xFF,0x00 },    // BORDER
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   { 0x00,0x10,0x38,0x54,0x10,0x10,0x00,0x00 }     // DEL
};

/* place to buffer the lcd display page */
/* maps as 4 lines, 16 characters (each character uses 8 bytes) */
#pragma udata gbuff1
static BYTE page[4][128];
#pragma udata


//-----------------------------------------------------------------------------
// WriteDisplay
// Send the 8-bit data in the specified mode
//-----------------------------------------------------------------------------
static void WriteDisplay(BYTE mode, BYTE data)
{
   CS1B_PIN = 0;
   A0_PIN = mode;
   SSPBUF = data;
   while(PIR1bits.SSPIF == 0);
   CS1B_PIN = 1;
   PIR1bits.SSPIF = 0;
}


//-----------------------------------------------------------------------------
// WriteString
// Overwites the string onto the display (string is in CONST memory)
//-----------------------------------------------------------------------------
static void WriteString(BYTE row, BYTE col, CONST char *ptr)
{
   BYTE ofst;

   col <<= 3;
   while (*ptr != 0x00)
   {
      for (ofst=0; ofst<8; ofst++)
          page[row][col+ofst] = ascii[*ptr][ofst];
      col += 8;
      ptr++;
   }
}

// Overwites the string onto the display (string is in local data memory)
static void WriteBytes(BYTE row, BYTE col, char *ptr)
{
   BYTE ofst;

   col <<= 3;
   while (*ptr != 0x00)
   {
      for (ofst=0; ofst<8; ofst++)
          page[row][col+ofst] = ascii[*ptr][ofst];
      col += 8;
      ptr++;
   }
}


/* initialize the newhaven graphics display */
void DispInit(void)
{
    // http://www.newhavendisplay.com/forum/viewtopic.php?f=7&t=18#p54
    WriteDisplay(LCD_CMND,0xA0);   // (8) Display RAM adress SEG output correspondence: normal
    WriteDisplay(LCD_CMND,0xAE);   // (1) LCD Display: OFF, hmmm
    WriteDisplay(LCD_CMND,0xC0);   // (15) Set COM output scan direction: normal
    WriteDisplay(LCD_CMND,0xA2);   // (11) Sets the LCD drive voltage bias ration: 1/9 bias
    WriteDisplay(LCD_CMND,0x2F);   // (16) Internal power supply mode : Booster on, Voltage regulator on, voltage follower on
    WriteDisplay(LCD_CMND,0x20);   // (17) Internal resistor ratio:
    WriteDisplay(LCD_CMND,0x81);   // (18) Set the volume register with 0x3d (below)
    WriteDisplay(LCD_CMND,0x3f);   //
}

/****************************************************************
*        NAME : DispClear
* DESCRIPTION : clear the memory display (needs DispUpdate)
*       INPUT : none
*      OUTPUT : none
*     RETURNS : none
****************************************************************/
void DispClear(void)
{
   MemClear((BYTE *)page, sizeof(page));
}

/****************************************************************
*        NAME : DispConstText
* DESCRIPTION : write (flash) text to the display (needs DispUpdate)
*       INPUT : row = display row (0-3)
*             : col = display column (0-15)
*             : textp = pointer to null terminated text string
*      OUTPUT : none
*     RETURNS : none
****************************************************************/
void DispConstText(BYTE row, BYTE col, CONST char *textp)
{
   WriteString(row, col, textp);
}

/****************************************************************
*        NAME : DispText
* DESCRIPTION : write (ram) text to the display (needs DispUpdate)
*       INPUT : row = display row (0-3)
*             : col = display column (0-15)
*             : textp = pointer to null terminated text string
*      OUTPUT : none
*     RETURNS : none
****************************************************************/
void DispText(BYTE row, BYTE col, char *textp)
{
   WriteBytes(row, col, textp);
}

/****************************************************************
*        NAME : DispUpdate
* DESCRIPTION : write out the buffer to the graphics display
*       INPUT : none
*      OUTPUT : none
*     RETURNS : none
****************************************************************/
void DispUpdate(void)
{
   BYTE row,col;

   WriteDisplay(LCD_CMND, 0xAE);         // LCD display off

   for (row=0; row<4; row++)
   {
      WriteDisplay(LCD_CMND, 0xB0+row);  // point to the first "row"
      WriteDisplay(LCD_CMND, 0x10);      // and the 0th column
      WriteDisplay(LCD_CMND, 0x10);      // Column Address Set requires two writes

      for (col=0; col<128; col++)
      {
         WriteDisplay(LCD_DATA, page[3-row][col]);
      }
   }

   WriteDisplay(LCD_CMND,0xAF);          // LCD display on
}

/****************************************************************
*        NAME : KeyInput
* DESCRIPTION : polls the keypad
*       INPUT : none
*      OUTPUT : none
*     RETURNS : 0 if no characters are present
*             : ascii character (0-9, *, #)
****************************************************************/
BYTE KeyInput(void)
{
   extern BYTE keydata;
   BYTE key;

   key = keydata;    /* get key pad data (if present) */
   keydata = 0;      /* use 0 as an indicator that no data is present */

   return(key);
}

/****************************************************************
*        NAME : MemCopy
* DESCRIPTION : moves a block of memory
*       INPUT : dstp = pointer to the destination block
*             : srcp = pointer to the source block
*             : max = number of bytes to move
*      OUTPUT : *dstp = *srcp
*     RETURNS : none
****************************************************************/
void MemCopy(BYTE *dstp, BYTE *srcp, int max)
{
   for (; max > 0; max--)
      *dstp++ = *srcp++;
}

/****************************************************************
*        NAME : MemClear
* DESCRIPTION : clears a block of memory
*       INPUT : dstp = pointer to the memory block
*             : max = number of bytes to clear
*      OUTPUT : *dstp = zeroes
*     RETURNS : none
****************************************************************/
void MemClear(BYTE *dstp, int max)
{
   for (; max > 0; max--)
      *dstp++ = 0;
}

